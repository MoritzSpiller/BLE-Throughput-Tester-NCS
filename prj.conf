## CMakeLists.txt
```
# SPDX-License-Identifier: Apache-2.0

cmake_minimum_required(VERSION 3.20.0)

find_package(Zephyr REQUIRED HINTS $ENV{ZEPHYR_BASE})
project(NONE)

FILE(GLOB app_sources src/*.c)
# NORDIC SDK APP START
target_sources(app PRIVATE
	${app_sources}
)
# NORDIC SDK APP END
```

## Kconfig
```
#
# Copyright (c) 2022 Nordic Semiconductor
#
# SPDX-License-Identifier: LicenseRef-Nordic-5-Clause
#

source "Kconfig.zephyr"

menu "BLE Tester App"

config BT_THROUGHPUT_FILE
	bool "BT file based throughput"
	default y

config BT_THROUGHPUT_DURATION
	int "Throughput test duration in milliseconds"
	default 20000

endmenu
```

## prj.conf
```kconfig
CONFIG_NCS_SAMPLES_DEFAULTS=y

CONFIG_SHELL=y

CONFIG_BT_DEVICE_NAME="BLE Tester"
CONFIG_BT=y
CONFIG_BT_DEBUG_LOG=y
CONFIG_BT_SMP=y
CONFIG_BT_PERIPHERAL=y
CONFIG_BT_CENTRAL=y
CONFIG_BT_MAX_CONN=2
CONFIG_BT_BONDABLE=n

CONFIG_BT_SCAN=y
CONFIG_BT_SCAN_FILTER_ENABLE=y
CONFIG_BT_SCAN_UUID_CNT=1

CONFIG_BT_GATT_CLIENT=y
CONFIG_BT_THROUGHPUT=y

CONFIG_BT_GATT_DM=y
CONFIG_HEAP_MEM_POOL_SIZE=2048

CONFIG_BT_USER_DATA_LEN_UPDATE=y
CONFIG_BT_USER_PHY_UPDATE=y
CONFIG_BT_GAP_AUTO_UPDATE_CONN_PARAMS=n

CONFIG_BT_BUF_ACL_RX_SIZE=502
CONFIG_BT_ATT_PREPARE_COUNT=2
# CONFIG_BT_ATT_TX_COUNT=10
CONFIG_BT_L2CAP_TX_MTU=498
CONFIG_BT_L2CAP_DYNAMIC_CHANNEL=y
CONFIG_BT_CONN_TX_MAX=10
CONFIG_BT_BUF_ACL_TX_COUNT=10
CONFIG_BT_BUF_ACL_TX_SIZE=502

CONFIG_BT_CTLR_DATA_LENGTH_MAX=251
CONFIG_BT_CTLR_PHY_2M=y
# CONFIG_BT_CTLR_PHY_CODED=y
CONFIG_BT_CTLR_SDC_MAX_CONN_EVENT_LEN_DEFAULT=4000000

CONFIG_DK_LIBRARY=y
CONFIG_DK_LIBRARY_DYNAMIC_BUTTON_HANDLERS=y

#! TEST
CONFIG_PRINTK=y
# CONFIG_COUNTER=y
CONFIG_NRFX_SAADC=y
CONFIG_NRFX_PPI=y
CONFIG_NRFX_DPPI=y
CONFIG_NRFX_TIMER4=y
CONFIG_NRFX_TIMER3=y
CONFIG_RING_BUFFER=y

#CONFIG_DT_HAS_NORDIC_NRF_TIMER_ENABLED=y
#CONFIG_COUNTER_NRF_TIMER=y
```

## app.overlay
```dts
/*
 * Copyright (c) 2024 Nordic Semiconductor ASA
 *
 * SPDX-License-Identifier: LicenseRef-Nordic-5-Clause
 */

 &uart0 {
    /delete-property/ hw-flow-control;
};
```

## nrf52dk_nrf52832.overlay
```dts
// To get started, press Ctrl+Space (or Option+Esc) to bring up the completion menu and view the available nodes.

// You can also use the buttons in the sidebar to perform actions on nodes.
// Actions currently available include:

// * Enabling / disabling the node
// * Adding the bus to a bus
// * Removing the node
// * Connecting ADC channels

// For more help, browse the DeviceTree documentation at https://docs.zephyrproject.org/latest/guides/dts/index.html
// You can also visit the nRF DeviceTree extension documentation at https://docs.nordicsemi.com/bundle/nrf-connect-vscode/page/guides/ncs_configure_app.html#devicetree-support-in-the-extension

&timer2 {
    status = "okay";
};
```

## src/main.c
```c
#include <zephyr/types.h>
#include <stddef.h>
#include <string.h>
#include <errno.h>
#include <zephyr/sys/byteorder.h>
#include <zephyr/kernel.h>
#include <zephyr/settings/settings.h>
#include <zephyr/logging/log.h>
#include <zephyr/bluetooth/bluetooth.h>
#include <zephyr/bluetooth/hci.h>
#include <zephyr/bluetooth/conn.h>
#include <zephyr/bluetooth/uuid.h>
#include <zephyr/bluetooth/gatt.h>
#include <dk_buttons_and_leds.h>
#include <zephyr/device.h>
#include <zephyr/drivers/counter.h>
#include "cts.h"

#define DELAY_US 1000000
#define COUNTER_MAX_US 1000000
#define ALARM_CHANNEL_ID 0
#define TIMER DT_NODELABEL(timer2)

#define LOG_MODULE_NAME app
LOG_MODULE_REGISTER(LOG_MODULE_NAME);

#define RUN_STATUS_LED DK_LED1
#define CONN_STATUS_LED DK_LED2
#define RUN_LED_BLINK_INTERVAL 1000

#define INTERVAL_MIN 12  /* 6 units, 7.5 ms, only used to setup connection */
#define INTERVAL_MAX 16 /* 16 units, 20 ms, only used to setup connection */

static struct bt_le_conn_param *conn_param = BT_LE_CONN_PARAM(INTERVAL_MIN, INTERVAL_MAX, 0, 400);
static struct bt_conn_le_phy_param *phy = BT_CONN_LE_PHY_PARAM_2M;
static struct bt_conn_le_data_len_param *data_len = BT_LE_DATA_LEN_PARAM_MAX;
static struct bt_conn *current_conn;
static struct bt_gatt_exchange_params exchange_params;

static uint8_t SEND_DATA = 0;
static uint8_t m_array[244] = {0};
static uint8_t m_array_size = 244;

struct counter_alarm_cfg alarm_cfg;
const struct device *const counter_dev = DEVICE_DT_GET(TIMER);

/* Bluetooth Callbacks */
void on_connected(struct bt_conn *conn, uint8_t err);
void on_disconnected(struct bt_conn *conn, uint8_t reason);
void on_notif_changed(enum bt_button_notifications_enabled status);
void on_data_received(struct bt_conn *conn, const uint8_t *const data, uint16_t len);

struct bt_conn_cb bluetooth_callbacks = {
    .connected = on_connected,
    .disconnected = on_disconnected,
};

struct bt_remote_service_cb remote_callbacks = {
    .notif_changed = on_notif_changed,
    .data_received = on_data_received,
};

/* Update Connection Parameters */
static void update_conn_params(struct bt_conn *conn)
{
    uint8_t err;

    err = bt_conn_le_phy_update(conn, phy);
    if (err) {
        LOG_INF("PHY update failed: %d\n", err);
    }

    err = bt_conn_le_param_update(conn, conn_param);
    if (err) {
        LOG_INF("Connection parameters update failed: %d", err);
    }

    err = bt_conn_le_data_len_update(conn, data_len);
    if (err) {
        LOG_INF("LE data length update failed: %d", err);
    }

    LOG_INF("Connection parameters successfully changed.");

    struct bt_conn_info info = {0};
    err = bt_conn_get_info(conn, &info);
    if (err) {
        LOG_INF("Failed to get connection info %d\n", err);
        return;
    }

    LOG_INF("Connection Interval: %d\n", info.le.interval);
    LOG_INF("Slave Latency: %d\n", info.le.latency);
    LOG_INF("RX PHY: %d\n", info.le.phy->rx_phy);
    LOG_INF("TX PHY: %d\n", info.le.phy->tx_phy);
    LOG_INF("RX Data Length: %d\n", info.le.data_len->rx_max_len);
    LOG_INF("TX Data Length: %d\n", info.le.data_len->tx_max_len);
    LOG_INF("RX Data Time: %d\n", info.le.data_len->rx_max_time);
    LOG_INF("TX Data Time: %d\n", info.le.data_len->tx_max_time);
}

/* MTU Exchange Function */
static void exchange_func(struct bt_conn *conn, uint8_t att_err, struct bt_gatt_exchange_params *params)
{
    struct bt_conn_info info = {0};
    int err;

    LOG_INF("MTU exchange %s\n", att_err == 0 ? "successful" : "failed");

    err = bt_conn_get_info(conn, &info);
    if (err) {
        LOG_INF("Failed to get connection info %d\n", err);
        return;
    }

    update_conn_params(current_conn);
}

/* Bluetooth Connection Callbacks */
void on_connected(struct bt_conn *conn, uint8_t err)
{
    if (err) {
        LOG_ERR("Connection error: %d", err);
        return;
    }
    LOG_INF("Connected.");
    current_conn = bt_conn_ref(conn);

    exchange_params.func = exchange_func;
    err = bt_gatt_exchange_mtu(conn, &exchange_params);
    if (err) {
        LOG_INF("MTU exchange failed (err %d)\n", err);
    } else {
        LOG_INF("MTU exchange pending\n");
    }

    dk_set_led_on(CONN_STATUS_LED);
}

void on_disconnected(struct bt_conn *conn, uint8_t reason)
{
    LOG_INF("Disconnected (reason: %d)", reason);
    dk_set_led_off(CONN_STATUS_LED);
    if (current_conn) {
        bt_conn_unref(current_conn);
        current_conn = NULL;
    }
}

void on_notif_changed(enum bt_button_notifications_enabled status)
{
    if (status == BT_BUTTON_NOTIFICATIONS_ENABLED) {
        LOG_INF("Notifications enabled");
        SEND_DATA = 1;
        // counter_start(counter_dev);
    } else {
        SEND_DATA = 0;
        counter_stop(counter_dev);
        // LOG_INF("Notifications disabled");
    }
}

void on_data_received(struct bt_conn *conn, const uint8_t *const data, uint16_t len)
{
    uint8_t temp_str[len + 1];
    memcpy(temp_str, data, len);
    temp_str[len] = 0x00;

    LOG_INF("Received data on conn %p. Len: %d", (void *)conn, len);
    LOG_INF("Data: %s", temp_str);
}

/* Button Handler */
void button_handler(uint32_t button_state, uint32_t has_changed)
{
    if (has_changed & button_state) {
        switch (has_changed) {
        case DK_BTN1_MSK:
            if (SEND_DATA == 0) {
                SEND_DATA = 1;
                counter_start(counter_dev);
            } else {
                SEND_DATA = 0;
                counter_stop(counter_dev);
            }
            break;
        case DK_BTN2_MSK:
            LOG_DBG("Button 2 not implemented.");
        case DK_BTN3_MSK:
            LOG_DBG("Button 3 not implemented.");
        case DK_BTN4_MSK:
            LOG_DBG("Button 4 not implemented.");
        default:
            break;
        }
    }
}

/* Configure Buttons and LEDs */
static void configure_dk_buttons_leds(void)
{
    int err;
    err = dk_leds_init();
    if (err) {
        LOG_ERR("Couldn't init LEDs (err %d)", err);
    }
    err = dk_buttons_init(button_handler);
    if (err) {
        LOG_ERR("Couldn't init buttons (err %d)", err);
    }
}

/* Calculate Throughput */
int calc_throughput(int secs)
{
    return get_bytes_sent() / secs;
}

/* Counter Timeout Handler */
static void counter_timeout_handler(const struct device *counter_dev, uint8_t chan_id, uint32_t ticks, void *user_data)
{
    struct counter_alarm_cfg *config = user_data;
    uint32_t now_ticks;
    uint64_t now_usec;
    int now_sec;
    int err;

    err = counter_get_value(counter_dev, &now_ticks);
    if (err) {
        LOG_INF("Failed to read counter value (err %d)", err);
        return;
    }

    now_usec = counter_ticks_to_us(counter_dev, now_ticks);
    now_sec = (int)(now_usec / USEC_PER_SEC);

    int current_throughput = calc_throughput(now_sec);

    if (now_sec >= 30) {
        LOG_INF("%u seconds sent.\n", now_sec);
        LOG_INF("Stopping timer\n");
        LOG_INF("Current throughput: %d bytes per second.\n", current_throughput);
        SEND_DATA = 0;
        counter_stop(counter_dev);
        return;
    } else {
        LOG_INF("%u seconds sent.\n", now_sec);
        LOG_INF("Current throughput: %d bytes per second.\n", current_throughput);
        // Set the counter alarm
        err = counter_set_channel_alarm(counter_dev, ALARM_CHANNEL_ID, config);
        LOG_INF("Set alarm in %u sec (%u ticks)\n",
            (uint32_t)(counter_ticks_to_us(counter_dev, alarm_cfg.ticks) / USEC_PER_SEC),
            alarm_cfg.ticks);
    }
}

/* Configure Timer */
int configure_timer(void)
{
    int err;

    LOG_INF("Counter alarm sample\n\n");

    if (!device_is_ready(counter_dev)) {
        LOG_INF("Device not ready.\n");
        return 0;
    }

    // Initialize alarm configuration
    alarm_cfg.flags = 0;
    alarm_cfg.ticks = counter_us_to_ticks(counter_dev, DELAY_US);
    alarm_cfg.callback = counter_timeout_handler;
    alarm_cfg.user_data = &alarm_cfg;

    // Set the counter alarm
    err = counter_set_channel_alarm(counter_dev, ALARM_CHANNEL_ID, &alarm_cfg);
    LOG_INF("Set alarm in %u sec (%u ticks)\n",
           (uint32_t)(counter_ticks_to_us(counter_dev, alarm_cfg.ticks) / USEC_PER_SEC),
           alarm_cfg.ticks);

    // Handle potential errors
    if (err == -EINVAL) {
        LOG_ERR("Alarm settings invalid\n");
    } else if (err == -ENOTSUP) {
        LOG_ERR("Alarm setting request not supported\n");
    } else if (err != 0) {
        LOG_ERR("Error\n");
    }

    return err;
}

/* Main Function */
int main(void)
{
    int err;
    int blink_status = 0;
    LOG_INF("Hello World! %s\n", CONFIG_BOARD);

    // Configure buttons and LEDs
    configure_dk_buttons_leds();

    // Configure the timer
    err = configure_timer();
    if (err) {
        LOG_INF("Couldn't configure timer, err: %d", err);
    }

    // Initialize Bluetooth
    err = bluetooth_init(&bluetooth_callbacks, &remote_callbacks);
    if (err) {
        LOG_INF("Couldn't initialize Bluetooth. err: %d", err);
    }

    LOG_INF("Running...");
    for (;;) {
        // Blink the status LED
        dk_set_led(RUN_STATUS_LED, (blink_status++) % 2);
        k_sleep(K_MSEC(RUN_LED_BLINK_INTERVAL));

        // Send data while SEND_DATA is set
        while (SEND_DATA == 1) {
            send_notification(current_conn, m_array);
            for (int i = 0; i < m_array_size; i++) {
                m_array[i]++;
            }
        }
    }
}
```

## src/adc.c
```c
#include <zephyr/kernel.h>
#include <zephyr/sys/printk.h>
#include <zephyr/logging/log.h>
#include "adc.h"
#include "rbuf.h"

/* STEP 2 - Include header for nrfx drivers */
#include <nrfx_saadc.h>
#include <nrfx_timer.h>
#include <helpers/nrfx_gppi.h>
#if defined(DPPI_PRESENT)
#include <nrfx_dppi.h>
#else
#include <nrfx_ppi.h>
#endif

//!: ADC docs: https://docs.nordicsemi.com/bundle/ncs-latest/page/nrfx/drivers/saadc/index.html

#define LOG_MODULE_NAME adc
LOG_MODULE_REGISTER(LOG_MODULE_NAME);

/* STEP 3.1 - Define the SAADC sample interval in microseconds */
#define SAADC_SAMPLE_INTERVAL_US 62

/* STEP 4.1 - Define the buffer size for the SAADC - was 8000 (M.S.) */
#define SAADC_BUFFER_SIZE 122

/* STEP 3.2 - Declaring an instance of nrfx_timer for TIMER1. */
const nrfx_timer_t timer_instance = NRFX_TIMER_INSTANCE(3);

/* STEP 4.2 - Declare the buffers for the SAADC */
static int16_t saadc_sample_buffer[2][SAADC_BUFFER_SIZE];

/* STEP 4.3 - Declare variable used to keep track of which buffer was last assigned to the SAADC driver */
static uint32_t saadc_current_buffer = 0;

// static uint16_t CC_VALUE = 1000;
static uint32_t ADC_EVT = 0;

static bool adc_ready = false;

static void adc_event_handler(nrfx_saadc_evt_t const *p_event)
{
    nrfx_err_t err;
    switch (p_event->type)
    {
    case NRFX_SAADC_EVT_READY:
        adc_ready = true;
        break;

    case NRFX_SAADC_EVT_BUF_REQ:

        /* STEP 5.2 - Set up the next available buffer. Alternate between buffer 0 and 1 */
        err = nrfx_saadc_buffer_set(saadc_sample_buffer[(saadc_current_buffer++) % 2], SAADC_BUFFER_SIZE);
        // err = nrfx_saadc_buffer_set(saadc_sample_buffer[((saadc_current_buffer == 0 )? saadc_current_buffer++ : 0)], SAADC_BUFFER_SIZE);
        if (err != NRFX_SUCCESS)
        {
            LOG_ERR("nrfx_saadc_buffer_set error: %08x", err);
            return;
        }
        break;

    case NRFX_SAADC_EVT_DONE:

        ADC_EVT += 1;
        if ((ADC_EVT % 1000) == 0) {
            LOG_INF("New ADC DONE event: %d", ADC_EVT);
        }
        
        // Write int16_t array to the ring buffer
        rbuf_put_data((uint8_t *)p_event->data.done.p_buffer, p_event->data.done.size*2);
        break;

    case NRFX_SAADC_EVT_FINISHED:
        LOG_INF("All buffers filled.");
        break;

    default:
        LOG_INF("Unhandled SAADC evt %d", p_event->type);
        break;
    }
}

static void adc_configure_timer(void)
{
    nrfx_err_t err;

    /* STEP 3.3 - Declaring timer config and intialize nrfx_timer instance. */
    nrfx_timer_config_t timer_config = NRFX_TIMER_DEFAULT_CONFIG(1000000);
    err = nrfx_timer_init(&timer_instance, &timer_config, NULL);
    if (err != NRFX_SUCCESS)
    {
        LOG_ERR("nrfx_timer_init error: %08x", err);
        return;
    }

    /* STEP 3.4 - Set compare channel 0 to generate event every SAADC_SAMPLE_INTERVAL_US. */
    uint32_t timer_ticks = nrfx_timer_us_to_ticks(&timer_instance, SAADC_SAMPLE_INTERVAL_US);
    nrfx_timer_extended_compare(&timer_instance, NRF_TIMER_CC_CHANNEL0, timer_ticks, NRF_TIMER_SHORT_COMPARE0_CLEAR_MASK, false);
}

static void adc_configure_ppi(void)
{
    nrfx_err_t err;
    /* STEP 6.1 - Declare variables used to hold the (D)PPI channel number */
    uint8_t m_saadc_sample_ppi_channel;
    uint8_t m_saadc_start_ppi_channel;

    /* STEP 6.2 - Trigger task sample from timer */
    err = nrfx_gppi_channel_alloc(&m_saadc_sample_ppi_channel);
    if (err != NRFX_SUCCESS)
    {
        LOG_ERR("nrfx_gppi_channel_alloc error: %08x", err);
        return;
    }

    err = nrfx_gppi_channel_alloc(&m_saadc_start_ppi_channel);
    if (err != NRFX_SUCCESS)
    {
        LOG_ERR("nrfx_gppi_channel_alloc error: %08x", err);
        return;
    }

    /* STEP 6.3 - Trigger task sample from timer */
    nrfx_gppi_channel_endpoints_setup(m_saadc_sample_ppi_channel,
                                      nrfx_timer_compare_event_address_get(&timer_instance, NRF_TIMER_CC_CHANNEL0),
                                      nrf_saadc_task_address_get(NRF_SAADC, NRF_SAADC_TASK_SAMPLE));

    /* STEP 6.4 - Trigger task start from end event */
    nrfx_gppi_channel_endpoints_setup(m_saadc_start_ppi_channel,
                                      nrf_saadc_event_address_get(NRF_SAADC, NRF_SAADC_EVENT_END),
                                      nrf_saadc_task_address_get(NRF_SAADC, NRF_SAADC_TASK_START));

    /* STEP 6.5 - Enable both (D)PPI channels */
    nrfx_gppi_channels_enable(BIT(m_saadc_sample_ppi_channel));
    nrfx_gppi_channels_enable(BIT(m_saadc_start_ppi_channel));
}

void adc_configure(void)
{
    adc_configure_timer();
    adc_configure_ppi();

    nrfx_err_t err;

    /* STEP 4.4 - Connect ADC interrupt to nrfx interrupt handler */
    IRQ_CONNECT(DT_IRQN(DT_NODELABEL(adc)),
                DT_IRQ(DT_NODELABEL(adc), priority),
                nrfx_isr, nrfx_saadc_irq_handler, 0);

    /* STEP 4.5 - Initialize the nrfx_SAADC driver */
    err = nrfx_saadc_init(DT_IRQ(DT_NODELABEL(adc), priority));
    if (err != NRFX_SUCCESS)
    {
        LOG_ERR("nrfx_saadc_init error: %08x", err);
        return;
    }

    /* STEP 4.6 - Declare the struct to hold the configuration for the SAADC channel used to sample the battery voltage */
    nrfx_saadc_channel_t channel = NRFX_SAADC_DEFAULT_CHANNEL_SE(NRF_SAADC_INPUT_AIN0, 0);

    /* STEP 4.7 - Change gain config in default config and apply channel configuration */
    channel.channel_config.gain = NRF_SAADC_GAIN1_6;
    err = nrfx_saadc_channels_config(&channel, 1);
    if (err != NRFX_SUCCESS)
    {
        LOG_ERR("nrfx_saadc_channels_config error: %08x", err);
        return;
    }

    /* STEP 4.8 - Configure channel 0 in advanced mode with event handler (non-blocking mode) */
    nrfx_saadc_adv_config_t saadc_adv_config = NRFX_SAADC_DEFAULT_ADV_CONFIG;
    err = nrfx_saadc_advanced_mode_set(BIT(0),
                                       NRF_SAADC_RESOLUTION_12BIT,
                                       &saadc_adv_config,
                                       adc_event_handler);
    if (err != NRFX_SUCCESS)
    {
        LOG_ERR("nrfx_saadc_advanced_mode_set error: %08x", err);
        return;
    }

    /* STEP 4.9 - Configure two buffers to make use of double-buffering feature of SAADC */
    err = nrfx_saadc_buffer_set(saadc_sample_buffer[0], SAADC_BUFFER_SIZE);
    if (err != NRFX_SUCCESS)
    {
        LOG_ERR("nrfx_saadc_buffer_set error: %08x", err);
        return;
    }
    err = nrfx_saadc_buffer_set(saadc_sample_buffer[1], SAADC_BUFFER_SIZE);
    if (err != NRFX_SUCCESS)
    {
        LOG_ERR("nrfx_saadc_buffer_set error: %08x", err);
        return;
    }

    /* STEP 4.10 - Trigger the SAADC. This will not start sampling, but will prepare buffer for sampling triggered through PPI */
    err = nrfx_saadc_mode_trigger();
    if (err != NRFX_SUCCESS)
    {
        LOG_ERR("nrfx_saadc_mode_trigger error: %08x", err);
        return;
    }
}

void adc_start_sampling(void)
{
    if (adc_ready) {
        nrfx_timer_enable(&timer_instance);
        LOG_INF("Sampling started.");
    } else {
        LOG_INF("adc not ready to start sampling.");
    }
    
}

void adc_stop_sampling(void)
{
    nrfx_timer_disable(&timer_instance);
    LOG_INF("Sampling stopped.");
}

uint32_t adc_get_bytes_acquired(void) {
    return (ADC_EVT * 244);
}
```

## src/adc.h
```c
#ifndef _ADC_H_
#define _ADC_H_

void adc_configure(void);
void adc_start_sampling(void);
void adc_stop_sampling(void);
uint32_t adc_get_bytes_acquired(void);

#endif /* _ADC_H_ */
```

## src/cts.c
```c
#include <zephyr/types.h>
#include <stddef.h>
#include <string.h>
#include <errno.h>
#include <zephyr/sys/printk.h>
#include <zephyr/sys/byteorder.h>
#include <zephyr/kernel.h>
#include <zephyr/bluetooth/bluetooth.h>
#include <zephyr/bluetooth/hci.h>
#include <zephyr/bluetooth/conn.h>
#include <zephyr/bluetooth/uuid.h>
#include <zephyr/bluetooth/gatt.h>
#include <zephyr/logging/log.h>
#include "cts.h"

#define LOG_MODULE_NAME remote
LOG_MODULE_REGISTER(LOG_MODULE_NAME);

static K_SEM_DEFINE(bt_init_ok, 0, 1);
static uint8_t char_value = 0;
static int bytes_sent = 0;

#define DEVICE_NAME CONFIG_BT_DEVICE_NAME
#define DEVICE_NAME_LEN (sizeof(DEVICE_NAME) - 1)

static struct bt_remote_service_cb remote_service_callbacks;

static const struct bt_data ad[] = {
    BT_DATA_BYTES(BT_DATA_FLAGS, (BT_LE_AD_GENERAL | BT_LE_AD_NO_BREDR)),
    BT_DATA(BT_DATA_NAME_COMPLETE, DEVICE_NAME, DEVICE_NAME_LEN)
};

static const struct bt_data sd[] = {
    BT_DATA_BYTES(BT_DATA_UUID128_ALL, BT_UUID_REMOTE_SERV_VAL),
};

/* Declarations */
static ssize_t read_characteristic_cb(struct bt_conn *conn, const struct bt_gatt_attr *attr, void *buf, uint16_t len, uint16_t offset);
void chrc_ccc_cfg_changed(const struct bt_gatt_attr *attr, uint16_t value);
static ssize_t on_write(struct bt_conn *conn, const struct bt_gatt_attr *attr, const void *buf, uint16_t len, uint16_t offset, uint8_t flags);

BT_GATT_SERVICE_DEFINE(remote_srv,
    BT_GATT_PRIMARY_SERVICE(BT_UUID_REMOTE_SERVICE),
    BT_GATT_CHARACTERISTIC(BT_UUID_REMOTE_BUTTON_CHRC,
        BT_GATT_CHRC_READ | BT_GATT_CHRC_NOTIFY,
        BT_GATT_PERM_READ,
        read_characteristic_cb, NULL, NULL),
    BT_GATT_CCC(chrc_ccc_cfg_changed, BT_GATT_PERM_READ | BT_GATT_PERM_WRITE),
    BT_GATT_CHARACTERISTIC(BT_UUID_REMOTE_MESSAGE_CHRC,
        BT_GATT_CHRC_WRITE_WITHOUT_RESP,
        BT_GATT_PERM_WRITE,
        NULL, on_write, NULL),
);

/* Callbacks */
void bt_ready(int err)
{
    if (err) {
        LOG_ERR("bt_ready returned %d", err);
    }
    k_sem_give(&bt_init_ok);
}

static ssize_t read_characteristic_cb(struct bt_conn *conn, const struct bt_gatt_attr *attr, void *buf, uint16_t len, uint16_t offset)
{
    return bt_gatt_attr_read(conn, attr, buf, len, offset, &char_value, sizeof(char_value));
}

void chrc_ccc_cfg_changed(const struct bt_gatt_attr *attr, uint16_t value)
{
    bool notif_enabled = (value == BT_GATT_CCC_NOTIFY);
    LOG_INF("Notifications %s", notif_enabled ? "enabled" : "disabled");
    if (remote_service_callbacks.notif_changed) {
        remote_service_callbacks.notif_changed(notif_enabled ? BT_BUTTON_NOTIFICATIONS_ENABLED : BT_BUTTON_NOTIFICATIONS_DISABLED);
    }
}

void on_sent(struct bt_conn *conn, void *user_data)
{
    ARG_UNUSED(user_data);
    bytes_sent += 244;
}

static ssize_t on_write(struct bt_conn *conn, const struct bt_gatt_attr *attr, const void *buf, uint16_t len, uint16_t offset, uint8_t flags)
{
    LOG_INF("Received data, handle %d, conn %p", attr->handle, (void *)conn);

    if (remote_service_callbacks.data_received) {
        remote_service_callbacks.data_received(conn, buf, len);
    }
    return len;
}

/* Remote Controller Functions */
int send_notification(struct bt_conn *conn, uint8_t *value)
{
    int err = 0;

    struct bt_gatt_notify_params params = {0};
    const struct bt_gatt_attr *attr = &remote_srv.attrs[2];

    params.attr = attr;
    params.data = &value;
    params.len = 244;
    params.func = on_sent;

    err = bt_gatt_notify_cb(conn, &params);

    return err;
}

void set_value(uint8_t value)
{
    char_value = value;
}

int bluetooth_init(struct bt_conn_cb *bt_cb, struct bt_remote_service_cb *remote_cb)
{
    int err;
    LOG_INF("Initializing Bluetooth");

    if (bt_cb == NULL || remote_cb == NULL) {
        return NRFX_ERROR_NULL;
    }
    bt_conn_cb_register(bt_cb);
    remote_service_callbacks.notif_changed = remote_cb->notif_changed;
    remote_service_callbacks.data_received = remote_cb->data_received;

    err = bt_enable(bt_ready);
    if (err) {
        LOG_ERR("bt_enable returned %d", err);
        return err;
    }

    k_sem_take(&bt_init_ok, K_FOREVER);

    err = bt_le_adv_start(BT_LE_ADV_CONN, ad, ARRAY_SIZE(ad), sd, ARRAY_SIZE(sd));
    if (err) {
        LOG_ERR("Couldn't start advertising (err = %d)", err);
        return err;
    }

    return err;
}

int get_bytes_sent(void)
{
    return bytes_sent;
}

void reset_bytes_sent(void)
{
    bytes_sent = 0;
}
```

## src/cts.h
```c
#ifdef __cplusplus
extern "C" {
#endif

/** @brief UUID of the Remote Service. **/
#define BT_UUID_REMOTE_SERV_VAL \
	BT_UUID_128_ENCODE(0xe9ea0001, 0xe19b, 0x482d, 0x9293, 0xc7907585fc48)

/** @brief UUID of the Button Characteristic. **/
#define BT_UUID_REMOTE_BUTTON_CHRC_VAL \
	BT_UUID_128_ENCODE(0xe9ea0002, 0xe19b, 0x482d, 0x9293, 0xc7907585fc48)

/** @brief UUID of the Message Characteristic. **/
#define BT_UUID_REMOTE_MESSAGE_CHRC_VAL \
	BT_UUID_128_ENCODE(0xe9ea0003, 0xe19b, 0x482d, 0x9293, 0xc7907585fc48)

#define BT_UUID_REMOTE_SERVICE          BT_UUID_DECLARE_128(BT_UUID_REMOTE_SERV_VAL)
#define BT_UUID_REMOTE_BUTTON_CHRC 	    BT_UUID_DECLARE_128(BT_UUID_REMOTE_BUTTON_CHRC_VAL)
#define BT_UUID_REMOTE_MESSAGE_CHRC 	BT_UUID_DECLARE_128(BT_UUID_REMOTE_MESSAGE_CHRC_VAL)

enum bt_button_notifications_enabled {
	BT_BUTTON_NOTIFICATIONS_ENABLED,
	BT_BUTTON_NOTIFICATIONS_DISABLED,
};

struct bt_remote_service_cb {
	void (*notif_changed)(enum bt_button_notifications_enabled status);
    void (*data_received)(struct bt_conn *conn, const uint8_t *const data, uint16_t len);
};

int send_notification(struct bt_conn *conn, uint8_t *value);
void set_value(uint8_t btn_value);
int bluetooth_init(struct bt_conn_cb *bt_cb, struct bt_remote_service_cb *remote_cb);
int get_bytes_sent(void);
void reset_bytes_sent(void);

#ifdef __cplusplus
}
#endif
```

## src/rbuf.c
```c
#include <zephyr/sys/ring_buffer.h>
#include <zephyr/kernel.h>
#include <zephyr/logging/log.h>

#include "rbuf.h"


//?: perform operations in memory?
//?: would this increase performance and/ or reduce memory usage
//!: Ring Buffer docs: https://docs.nordicsemi.com/bundle/ncs-latest/page/zephyr/kernel/data_structures/ring_buffers.html

#define LOG_MODULE_NAME ring_buffer
LOG_MODULE_REGISTER(LOG_MODULE_NAME);

#define RING_BUF_SIZE 10000

uint8_t ring_buffer_data[RING_BUF_SIZE];
struct ring_buf ring_buffer;
static uint32_t overwrites = 0;
static uint32_t counter = 0;
static uint32_t bytes_read = 0;
static uint32_t bytes_written = 0;

// Global variable to store the callback function pointer
overwrite_callback_t overwrite_callback = NULL;

void buffer_overwrite_callback(void) {

    overwrites++;

    if (overwrite_callback) {
        overwrite_callback(overwrites);
    } else {
        LOG_DBG("data overwritten.");
    }
}

void rbuf_init(overwrite_callback_t callback) {
    ring_buf_init(&ring_buffer, sizeof(ring_buffer_data), ring_buffer_data);
    overwrite_callback = callback;
}

int rbuf_put_data(uint8_t *data, size_t length) {
    int ret = ring_buf_put(&ring_buffer, data, length);
    counter++;
    bytes_written += ret;

    if (ret < length) {
        //?: this works, so data is not overwritten but also not added to the buffer --> data is lost
        buffer_overwrite_callback();
        // LOG_INF("put_head: %d", ring_buffer.put_head);
        // LOG_INF("put_tail: %d", ring_buffer.put_tail);
        // LOG_INF("put_base: %d", ring_buffer.put_base);
        // LOG_INF("get_head: %d", ring_buffer.get_head);
        // LOG_INF("get_tail: %d", ring_buffer.get_tail);
        // LOG_INF("get_base: %d", ring_buffer.get_base);
        // LOG_INF("size: %d", ring_buffer.size);
    }
    return ret;
}

int rbuf_get_data(uint8_t *data, size_t length) {
    int ret = ring_buf_get(&ring_buffer, data, length);
    bytes_read += ret;
    return ret;
}

uint32_t rbuf_get_size(void) {
    return (RING_BUF_SIZE - ring_buf_space_get(&ring_buffer));
}

uint32_t rbuf_get_put_head(void) {
    return ring_buffer.put_head;
}

uint32_t rbuf_get_get_head(void) {
    return ring_buffer.get_head;
}

uint32_t rbuf_get_bytes_read(void) {
    return bytes_read;
}

uint32_t rbuf_get_bytes_written(void) {
    return bytes_written;
}
```

## src/rbuf.h
```c
#ifndef _RBUF_H_
#define _RBUF_H_

#include <stdint.h>
#include <stddef.h>

// Define a function pointer type for the callback
typedef void (*overwrite_callback_t)(uint32_t);

void rbuf_init(overwrite_callback_t callback);

int rbuf_put_data(uint8_t *data, size_t length);

int rbuf_get_data(uint8_t *data, size_t length);

uint32_t rbuf_get_size(void);
uint32_t rbuf_get_put_head(void);
uint32_t rbuf_get_get_head(void);
uint32_t rbuf_get_bytes_read(void);
uint32_t rbuf_get_bytes_written(void);

#endif /* _ADC_H_ */
```
